#include <stdlib.h>
#include <unistd.h>
#include <stdio.h>
#include <math.h>
#include <time.h>
#include <vector>
#include <fstream>

#include "mailbox.h"
#include "gpu_fft.h"

using namespace std;

char Usage[] =
    "Usage: hello_fft.bin log2_N [jobs [loops]]\n"
    "log2_N = log2(FFT_length),       log2_N = 8...22\n"
    "jobs   = transforms per batch,   jobs>0,        default 1\n"
    "loops  = number of test repeats, loops>0,       default 1\n";


vector<float> getInput(int nfreq) {
    int n=1024;

    vector<float> values;

    for(int i=0; i<n; i++)
        values.push_back(0);

    vector<float> freq;

    for(int i=0; i<nfreq; i++)
        freq.push_back(i+1);

    for(float f : freq)
        for(int i=0; i<values.size(); i++)
                values[i] += sin(2*M_PI*f*i/n);
    return values;
}

float sine02[] = {2.000000,1.999962,1.999849,1.999660,1.999397,1.999058,1.998644,1.998155,1.997590,1.996950,1.996235,1.995445,1.994580,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1.999849,1.999961};
float sine01[] = {1, 1.00614, 1.01227, 1.01841, 1.02454, 1.03067, 1.03681, 1.04294, 1.04907, 1.0552, 1.06132, 1.06744, 1.07356,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 0.987728, 0.993864};
float sine00[] = {0, 1.88247e-05, 7.52982e-05, 0.000169418, 0.000301181, 0.000470583, 0.000677615, 0.000922272, 0.00120454, 0.00152442, 0.00188189, 0.00227693, 0.00270954,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 7.52982e-05, 1.88247e-05};

unsigned microseconds(void) {
    struct timespec ts;
    clock_gettime(CLOCK_REALTIME, &ts);
    return ts.tv_sec*1000000 + ts.tv_nsec/1000;
}

int main(int argc, char *argv[]) {
    int i, j, k, ret, loops, freq, log2_N, jobs, N;
    int mailbox = mbox_open();      // mailbox descriptor
    unsigned t[2];
    ofstream fr("plot_real.txt");
    ofstream fi("plot_img.txt");

    /*
    struct GPU_FFT_COMPLEX {
    float re, im;
    };
    */
    struct GPU_FFT_COMPLEX *base;

    /*
    struct GPU_FFT {
    struct GPU_FFT_BASE base;
    struct GPU_FFT_COMPLEX *in, *out;
    int x, y, step;
    };
    */
    struct GPU_FFT *fft;

    log2_N = 10; //argc>1? atoi(argv[1]) : 12; // 8 <= log2_N <= 22
    jobs   = 1;	//argc>2? atoi(argv[2]) : 1;  // transforms per batch
    loops  = 1;	//argc>3? atoi(argv[3]) : 1;  // test repetitions

    N = 1<<log2_N; // FFT length
    // init the fields if GPU_FFT* fft
    ret = gpu_fft_prepare(mailbox, log2_N, GPU_FFT_REV, jobs, &fft); // call once

    switch(ret) {
        case -1: printf("Unable to enable V3D. Please check your firmware is up to date.\n"); return -1;
        case -2: printf("log2_N=%d not supported.  Try between 8 and 22.\n", log2_N);         return -1;
        case -3: printf("Out of memory.  Try a smaller batch or increase GPU memory.\n");     return -1;
        case -4: printf("Unable to map Videocore peripherals into ARM memory space.\n");      return -1;
        case -5: printf("Can't open libbcm_host.\n");                                         return -1;
    }

    // run 1 job (jobs = 1, j=0) for 1 loop (k=0)
    // convert to forward FFT, input: an array of sin(2*pi*freq*i/N)
    //                                  i=0, N-1;
    //                          output: the frequency domain of the input:

    // set the input data
    base = fft->in + 0*fft->step; // input buffer

    for (int i=0; i<N; i++) {
        base[i].re = 0;
	base[i].im = 0;
    }
    /*
	In order to get a sine wave of freq. f as output, (in [-2, 2]), set base[f]
	and base[N-f] to 1.
    */
	int f = atoi(argv[1]);
	base[f].re = 1;
	base[N-f].im = 1;
	//base[3].re = 1;
	//base[N-3].re = 1;

    usleep(1); // Yield to OS
    // timing call
    gpu_fft_execute(fft);   // do the transform
    // timing call

    //j=0, N=FFT length
    base = fft->out + 0*fft->step; // output buffer

    // print results
    vector<float> reals, imaginaries, s;

    for(int i=0; i<N; i++) {
	fr<<base[i].re<<",";
	fi<<base[i].im<<",";
        reals.push_back(base[i].re);
	imaginaries.push_back(base[i].im);
    }

    printf("%d ", N);

    printf("\nReals:");
    for(float& re : reals)
	printf("%f ", re);

    printf("\n\n\n\Imaginaries:");
    for(float& im : imaginaries)
	printf("%f ", im);

    printf("\n\n\nSum:");

    for(int i=0; i<N; i++)
	printf("%f ", (pow(reals[i], 2)+pow(imaginaries[i], 2)));

    printf("\n");
    fr.close();
    fi.close();


    gpu_fft_release(fft); // Videocore memory lost if not freed !
    return 0;
}
